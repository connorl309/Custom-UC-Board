/*###ICF### Section handled by ICF editor, don't touch! ****/
/*-Editor annotation file-*/
/* IcfEditorFile="$TOOLKIT_DIR$\config\ide\IcfEditor\cortex_v1_0.xml" */
/*-Specials-*/
define symbol __ICFEDIT_intvec_start__ = 0x00000000;
/*-Memory Regions-*/
define symbol __ICFEDIT_region_ROM_start__ = 0x00000000;
define symbol __ICFEDIT_region_ROM_end__   = 0x000FFFFF;
define symbol __ICFEDIT_region_RAM_start__ = 0x20000000;
define symbol __ICFEDIT_region_RAM_end__   = 0x200807FF;
/*-Sizes-*/
define symbol __ICFEDIT_size_cstack__   = 0x400;
define symbol __ICFEDIT_size_svcstack__ = 0x0;
define symbol __ICFEDIT_size_irqstack__ = 0x0;
define symbol __ICFEDIT_size_fiqstack__ = 0x0;
define symbol __ICFEDIT_size_undstack__ = 0x0;
define symbol __ICFEDIT_size_abtstack__ = 0x0;
define symbol __ICFEDIT_size_heap__     = 0x400;
/**** End of ICF editor section. ###ICF###*/

define memory mem with size = 4G;
define region ROM_region   = mem:[from __ICFEDIT_region_ROM_start__   to __ICFEDIT_region_ROM_end__];
define region RAM_region   = mem:[from __ICFEDIT_region_RAM_start__   to __ICFEDIT_region_RAM_end__];

define block CSTACK    with alignment = 8, size = __ICFEDIT_size_cstack__   { };
define block HEAP      with alignment = 8, size = __ICFEDIT_size_heap__     { };

define block FLASH_CODE_ROM  {section FLASH_ROM_init object main.o, section .text_init object tmpm46b_fc.o}; 
define block FLASH_CODE_RAM  {section FLASH_ROM object main.o, section .text object tmpm46b_fc.o};

define symbol __ICFEDIT_size_swp__   = 0x2000;
define block FLASH_SWP  with alignment = 8, size = __ICFEDIT_size_swp__{ };
define block RAM_SWP  with alignment = 8, size = __ICFEDIT_size_swp__{ };

initialize by copy { readwrite };
initialize manually { section FLASH_ROM object main.o, section .text object tmpm46b_fc.o};  
do not initialize  { section .noinit };

place at address mem:__ICFEDIT_intvec_start__ { readonly section .intvec };
place at address mem: 0x00000400 { block FLASH_CODE_ROM }; 
place at address mem: 0x00010000 { block FLASH_SWP };
place at address mem: 0x20000000 { block FLASH_CODE_RAM, block RAM_SWP }; 
place at address mem: 0x2001B600 { readwrite };
place at address mem: 0x2001F000 { block CSTACK, block HEAP };

place in ROM_region   { readonly };
